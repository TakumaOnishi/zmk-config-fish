## config/boards/shields/fish/Kconfig.defconfig
```kconfig
# Copyright (c) 2021 The ZMK Contributors
# SPDX-License-Identifier: MIT


if SHIELD_FISH_LEFT

config ZMK_KEYBOARD_NAME
    default "Fish Keyboard"

config ZMK_SPLIT
    default n

endif
```

## config/boards/shields/fish/Kconfig.shield
```kconfig
# Copyright (c) 2021 The ZMK Contributors
# SPDX-License-Identifier: MIT

config SHIELD_FISH_LEFT
    def_bool $(shields_list_contains,fish_left)
```
